## arch/risc-v/src/mindgrove/Kconfig
```kconfig
config MG_CLOCK_FREQUENCY
    int "Mindgrove Clock Frequency (Hz)"
    default 700000000
    help
        This defines the system clock frequency used by peripherals.

#
# Mindgrove Peripheral Configuration
#

comment "Mindgrove Peripheral Support"

# =========================
# UART SECTION
# =========================

config MINDGROVE_HAVE_UART0
    bool
    default y

config MINDGROVE_UART0
    bool "Enable UART0"
    default y
    depends on MINDGROVE_HAVE_UART0
    select UART0_SERIALDRIVER
    select ARCH_HAVE_SERIAL_TERMIOS
    select MINDGROVE_UART


config MINDGROVE_HAVE_UART1
    bool
    default y

config MINDGROVE_UART1
    bool "Enable UART1"
    default y
    depends on MINDGROVE_HAVE_UART1
    select UART1_SERIALDRIVER
    select ARCH_HAVE_SERIAL_TERMIOS
    select MINDGROVE_UART


config MINDGROVE_HAVE_UART2
    bool
    default y

config MINDGROVE_UART2
    bool "Enable UART2"
    default y
    depends on MINDGROVE_HAVE_UART2
    select UART2_SERIALDRIVER
    select ARCH_HAVE_SERIAL_TERMIOS
    select MINDGROVE_UART


config MINDGROVE_HAVE_UART3
    bool
    default y

config MINDGROVE_UART3
    bool "Enable UART3"
    default y
    depends on MINDGROVE_HAVE_UART3
    select UART3_SERIALDRIVER
    select ARCH_HAVE_SERIAL_TERMIOS
    select MINDGROVE_UART


config MINDGROVE_HAVE_UART4
    bool
    default y

config MINDGROVE_UART4
    bool "Enable UART4"
    default y
    depends on MINDGROVE_HAVE_UART4
    select UART4_SERIALDRIVER
    select ARCH_HAVE_SERIAL_TERMIOS
    select MINDGROVE_UART

# =========================
# GPIO SECTION
# =========================

config MINDGROVE_HAVE_GPIO
    bool
    default y

config MINDGROVE_GPIO
    bool "GPIO Support"
    default n
    depends on MINDGROVE_HAVE_GPIO
    depends on DEV_GPIO


# =========================
# SPI SECTION
# =========================

config SPI_HWFEATURES
    bool "SPI Hardware Features"
    default n
    depends on SPI_DRIVER

config MINDGROVE_HAVE_SPI0
    bool
    default y

config MINDGROVE_SPI0
    bool "Enable SPI0"
    default y
    depends on MINDGROVE_HAVE_SPI0
    select MINDGROVE_SPI
    select SPI_DRIVER


config MINDGROVE_HAVE_SPI1
    bool
    default y

config MINDGROVE_SPI1
    bool "Enable SPI1"
    default y
    depends on MINDGROVE_HAVE_SPI1
    select MINDGROVE_SPI
    select SPI_DRIVER


config MINDGROVE_HAVE_SPI2
    bool
    default y

config MINDGROVE_SPI2
    bool "Enable SPI2"
    default y
    depends on MINDGROVE_HAVE_SPI2
    select MINDGROVE_SPI
    select SPI_DRIVER


config MINDGROVE_HAVE_SPI3
    bool
    default y

config MINDGROVE_SPI3
    bool "Enable SPI3"
    default y
    depends on MINDGROVE_HAVE_SPI3
    select MINDGROVE_SPI
    select SPI_DRIVER
    
# =========================
# I2C SECTION
# =========================

config MINDGROVE_HAVE_I2C0
    bool
    default y

config MINDGROVE_I2C0
    bool "Enable I2C0"
    default y
    depends on MINDGROVE_HAVE_I2C0
    select MINDGROVE_I2C
    select I2C
    select I2C_CHARDRIVER


config MINDGROVE_HAVE_I2C1
    bool
    default y

config MINDGROVE_I2C1
    bool "Enable I2C1"
    default y
    depends on MINDGROVE_HAVE_I2C1
    select MINDGROVE_I2C
    select I2C
    select I2C_CHARDRIVER
```

## boards/risc-v/mindgrove/secure-iot/Kconfig
```kconfig
if ARCH_BOARD_MINDGROVE_SECURE_IOT

config BOARD_MINDGROVE_PWM
    bool "Enable Mindgrove PWM Driver"
    depends on PWM
    select PWM_MULTICHAN
    default y

endif
```
